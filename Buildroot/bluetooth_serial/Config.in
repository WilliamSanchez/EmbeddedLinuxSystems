## Buildroot/bluetooth_serial/Config.in
```kconfig
config BR2_PACKAGE_BLUETOOTH_SERIAL
	bool "bluetooth to serial"
	help
	  A service to communciate with a evice using bluetooth protocol
```

## Buildroot/mlx90640_ir/Config.in
```kconfig
config BR2_PACKAGE_MLX90640_IR
	bool "User to set a mlx90640 camera ir"
	help
	  configure a camera ir
```
