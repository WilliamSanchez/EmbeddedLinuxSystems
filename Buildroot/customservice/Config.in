## Buildroot/customservice/Config.in
```kconfig
config BR2_PACKAGE_CUSTOMSERVICE
	bool "customservice"
	help
	  A friendly service program that print a message
```

## Buildroot/uav_project/Config.in
```kconfig
config BR2_PACKAGE_UAV_PROJECT
	bool "Special project UAV"
	help
	  target to build a control, navigationa an guide project for an UAV
```

## Buildroot/user_gpio-irq_interface/Config.in
```kconfig
config BR2_PACKAGE_USER_GPIO_IRQ_INTERFACE
	bool "GPIO-IRQ_LED user space driver"
	help
	  A service to get interrupts from custom device driver
```

## Buildroot/user_lidar/Config.in
```kconfig
config BR2_PACKAGE_USER_LIDAR
	bool "User lidar to avoid obstacles"
	help
	  A service to measrement distance around to avoid obstacles
```

## Buildroot/user_pwm/Config.in
```kconfig
config BR2_PACKAGE_USER_PWM
	bool "User to set a server motor"
	help
	  configure a servo motor pwm
```

## Yocto/meta-nova/conf/layer.conf
```bitbake
# We have a conf and classes directory, add to BBPATH
BBPATH .= ":${LAYERDIR}"

# We have recipes-* directories, add to BBFILES
BBFILES += "${LAYERDIR}/recipes-*/*/*.bb \
            ${LAYERDIR}/recipes-*/*/*.bbappend"

BBFILE_COLLECTIONS += "meta-nova"
BBFILE_PATTERN_meta-nova = "^${LAYERDIR}/"
BBFILE_PRIORITY_meta-nova = "6"

LAYERDEPENDS_meta-nova = "core"
LAYERSERIES_COMPAT_meta-nova = "kirkstone"
```

## Yocto/meta-qt-rpi/conf/layer.conf
```bitbake
# We have a conf and classes directory, add to BBPATH
BBPATH .= ":${LAYERDIR}"

# We have recipes-* directories, add to BBFILES
BBFILES += "${LAYERDIR}/recipes-*/*/*.bb \
            ${LAYERDIR}/recipes-*/*/*.bbappend"

BBFILE_COLLECTIONS += "meta-qt-rpi"
BBFILE_PATTERN_meta-qt-rpi = "^${LAYERDIR}/"
BBFILE_PRIORITY_meta-qt-rpi = "6"

LAYERDEPENDS_meta-qt-rpi = "core"
LAYERSERIES_COMPAT_meta-qt-rpi = "kirkstone"
```
